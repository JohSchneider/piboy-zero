/dts-v1/;
/plugin/;

/ {
  compatible = "brcm,bcm2708";

  fragment@0 {
    target = <&gpio>;
    __overlay__ {
      pinctrl-names = "default";
      pinctrl-0 = <&button_input_pins>;

    button_input_pins: button_input_pins {
	/* function      A    B    Down  Cen   Left  Sel  X    Y    Sh-R Up    Sh-L Rig   Sta */
	/* schematic:    btn1 btn2 dpad3 dpad1 dpad5 btn8 btn3 btn4 btn6 dpad2 btn5 dpad4 btn7 */
	/* physical pins:13   15   29    31    35    37   16   18   26   32    36   38    40  */
	/* BCM pin:      27   22   5     6     19    26   23   24   7    12    16   20    21  */
	brcm,pins =     <27   22   5     6     19    26   23   24   7    12    16   20    21>;   /* gpio no ('BCM' number) */
	brcm,function = <0    0    0     0     0     0    0    0    0    0     0    0     0>; /* 0:in, 1:out, 2: alt5, 3: alt4, 4: alt0, 5: alt1, 6: alt2, 7: alt3 */
	brcm,pull     = <2    2    2     2     2     2    2    2    2    2     2    2     2>; /* 2:up 1:down 0:none */
      };
    };
  };
 };
